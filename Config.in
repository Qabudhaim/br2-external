## Config.in
```kconfig
menu "External packages"

source "$BR2_EXTERNAL_BR2_EXTERNAL_PATH/package/esp-hosted/Config.in"
source "$BR2_EXTERNAL_BR2_EXTERNAL_PATH/package/device-agent/Config.in"
source "$BR2_EXTERNAL_BR2_EXTERNAL_PATH/package/go-toolchain/Config.in"

endmenu
```

## package/device-agent/Config.in
```kconfig
config BR2_PACKAGE_DEVICE_AGENT
	bool "device-agent"
	select BR2_PACKAGE_HOST_GO_TOOLCHAIN
	help
	  Lightweight device management agent written in Go.
```

## package/esp-hosted/Config.in
```kconfig
config BR2_PACKAGE_ESP_HOSTED
    bool "esp-hosted"
    help
      ESP32 WiFi/BLE hosted driver
```

## package/go-custom/Config.in
```kconfig
config BR2_PACKAGE_HOST_GO_CUSTOM
	bool "host go-custom"
	help
	  Custom Go toolchain for building Go applications.

	  This package installs a custom host Go compiler
	  instead of using Buildroot's default Go version.
```

## package/go-toolchain/Config.in
```kconfig
config BR2_PACKAGE_HOST_GO_TOOLCHAIN
	bool "host go-toolchain"
	help
	  Go toolchain for building Go applications.

	  This package installs a host Go compiler.
```
